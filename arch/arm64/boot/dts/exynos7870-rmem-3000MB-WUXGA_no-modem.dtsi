/*
 * SAMSUNG EXYNOS device tree source for reserved-memory
 *
 * Copyright (c) 2015 Samsung Electronics Co., Ltd.
 *		http://www.samsung.com
 *
 * This program is free software; you can redistribute it and/or modify
 * it under the terms of the GNU General Public License version 2 as
 * published by the Free Software Foundation.
*/

#include "exynos7870-rmem-3000MB-WUXGA.dtsi"

/ {
	reserved-memory {
		/delete-node/ modem_if@F0000000;
		/delete-node/ gnss_if@F7C00000;
		/delete-node/ dram_init@EFFFF000;
	};
};
